## CMakeLists.txt
```
# SPDX-License-Identifier: Apache-2.0

cmake_minimum_required(VERSION 3.13.1)
include($ENV{ZEPHYR_BASE}/cmake/app/boilerplate.cmake NO_POLICY_SCOPE)
project(nrf52-fade)

FILE(GLOB app_sources src/*.c)
target_sources(app PRIVATE ${app_sources})
```

## prj.conf
```kconfig
CONFIG_SERIAL=n

# PWM
CONFIG_PWM=y
CONFIG_PWM_NRF5_SW=n
CONFIG_PWM_NRFX=y
CONFIG_PWM_0=y
```

## nrf52840_pca10059.overlay
```dts
&pwm0 {
	status = "okay";
	ch0-pin = <8>;
	ch1-pin = <41>;
	ch2-pin = <12>;
	//ch0-inverted;
};
```

## src/main.c
```c
#include <zephyr.h>

#include "rgb_led.h"

#define SLEEP_MS	2

void main(void)
{
	rgb_led_init();

	rgb_led_set(0,0xff,0);

	int8_t state = 0;
	int8_t mask = 0x7;
	int32_t val = 0;

	while (1) {
		k_sleep(SLEEP_MS);
		rgb_led_set(
			(mask & 0x1) ? val : 0,
			(mask & 0x2) ? val : 0,
			(mask & 0x4) ? val : 0);

		val += (state & 0x10) == 0 ? 2 : -2;

		if (val >= 0xFE) {
			state ^= 0x10;
		} else if (val < 0x01) {
			state ^= 0x10;

			// change color
			switch(mask) {
				case 0x1: mask = 0x2; break;
				case 0x2: mask = 0x4; break;
				case 0x4: mask = 0x7; break;
				default: mask = 0x1;
			}
		}
	}
}
```

## src/rgb_led.c
```c
#include <zephyr.h>
#include <misc/printk.h>
#include <device.h>
#include <drivers/pwm.h>


#if defined(DT_NORDIC_NRF_PWM_PWM_0_LABEL) && defined(DT_NORDIC_NRF_PWM_PWM_0_CH0_PIN)
#define PWM_DRIVER	DT_NORDIC_NRF_PWM_PWM_0_LABEL
#define RED_PIN     DT_NORDIC_NRF_PWM_PWM_0_CH0_PIN
#define GREEN_PIN   DT_NORDIC_NRF_PWM_PWM_0_CH1_PIN
#define BLUE_PIN    DT_NORDIC_NRF_PWM_PWM_0_CH2_PIN
#else
#error "NRF PWM config not found"
#endif

#define PERIOD (USEC_PER_SEC / 100)

struct device *pwm_dev;

void rgb_led_init()
{
    pwm_dev = device_get_binding(PWM_DRIVER);

	if (!pwm_dev) {
		printk("Cannot find PWM device!\n");
		return;
	}
}

void rgb_led_set(u32_t r, u32_t g, u32_t b)
{
    if( pwm_pin_set_usec(pwm_dev, RED_PIN, PERIOD, ((255 - (r & 0xff)) * PERIOD) >> 8) != 0 ||
        pwm_pin_set_usec(pwm_dev, GREEN_PIN, PERIOD, ((255 - (g & 0xff)) * PERIOD) >> 8) != 0 ||
        pwm_pin_set_usec(pwm_dev, BLUE_PIN, PERIOD, ((255 - (b & 0xff)) * PERIOD) >> 8) != 0) {
        printk("PWM pin write fails!\n");
		return;
    }
}
```
